/dts-v1/;
/plugin/;

/ {
    compatible = "allwinner,sun4i-a10", "allwinner,sun7i-a20", "allwinner,sun8i-h3", "allwinner,sun50i-a64", "allwinner,sun50i-h5";

    fragment@0 {
        target-path = "/";
        __overlay__ {
            lcd_screen: auxdisplay {
                compatible = "hit,hd44780";

                data-gpios = <&pio 7 9 0>,
                             <&pio 8 3 0>,
                             <&pio 1 2 0>,
                             <&pio 7 7 0>;
                enable-gpios = <&pio 8 19>;
                rs-gpios = <&pio 8 19 0>;

                display-height-chars = <2>;
                display-width-chars = <16>;
            };

        };
    };

    fragment@1 {
       target = <&lcd_screen>;
        __dormant__ {
            backlight-gpios = <&pio 7 10 0>;
        };
    };

    __overrides__ {
        pin_d4 = <&lcd_screen>,"data-gpios:4";
        pin_d5 = <&lcd_screen>,"data-gpios:16";
        pin_d6 = <&lcd_screen>,"data-gpios:28";
        pin_d7 = <&lcd_screen>,"data-gpios:40";
        pin_en = <&lcd_screen>,"enable-gpios:4";
        pin_rs = <&lcd_screen>,"rs-gpios:4";
        pin_bl = <0>,"+1", <&lcd_screen>,"backlight-gpios:4";
        display_height = <&lcd_screen>,"display-height-chars:0";
        display_width = <&lcd_screen>,"display-width-chars:0";
    };

};