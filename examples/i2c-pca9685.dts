/dts-v1/;
/plugin/;

/{
	compatible = "allwinner,sun4i-a10", "allwinner,sun7i-a20";

	fragment@0 {
		target = <&i2c2>;
		__overlay__ {
			#address-cells = <1>;
			#size-cells = <0>;
			status = "okay";

			pca: pca@40 {
				compatible = "nxp,pca9685-pwm";
				#pwm-cells = <2>;
				reg = <0x40>;
				status = "okay";
			};
		};
	};
	__overrides__ {
		addr = <&pca>,"reg:0";
	};
};
