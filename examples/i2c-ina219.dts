/dts-v1/;
/plugin/;

/ {
	compatible = "allwinner,sun4i-a10", "allwinner,sun7i-a20", "allwinner,sun8i-h3", "allwinner,sun50i-a64", "allwinner,sun50i-h5";

	fragment@0 {
		target = <&i2c2>;
		__overlay__ {
			#address-cells = <1>;
			#size-cells = <0>;
			ina219@40 {
				compatible = "ti,ina2xx";
				reg = <0x40>;
				status = "okay";
				shunt-resistor = <100000>;
			};
		};
	};
};
