/dts-v1/;
/plugin/;

/{
    compatible = "allwinner,sun4i-a10", "allwinner,sun7i-a20";

    fragment@0{

        target = <&usb_otg>;

        __overlay__{

            dr_mode = "host";

        };

    };

};
