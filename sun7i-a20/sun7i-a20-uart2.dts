/dts-v1/;
/plugin/;

/ {
	compatible = "allwinner,sun7i-a20";

	fragment@0 {
		target-path = "/aliases";
		__overlay__ {
			serial2 = "/soc/serial@01c28800";
		};
	};

	fragment@1 {
		target = <&uart2>;
		 __overlay__ {
			pinctrl-names = "default";
			pinctrl-0 = <&uart2_pi_pins_2>;
			status = "okay";
		};
	};
};
