/dts-v1/;
/plugin/;

/ {
	compatible = "allwinner,sun7i-a20";

	fragment@0 {
		target-path = "/aliases";
		__overlay__ {
			serial3 = "/soc/serial@01c28c00";
		};
	};

	fragment@2 {
		target = <&uart3>;
		 __overlay__ {
			pinctrl-names = "default";
			pinctrl-0 = <&uart3_pg_pins_2>;
			status = "okay";
		};
	};
};
